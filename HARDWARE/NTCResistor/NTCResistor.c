#include "NTCResistor/NTCResistor.h"
#include "NTCResistor/adc.h"
#include "../USER/cPrintf.h"

#include "../HMI/cmd_process.h"
#include "../UILogic/pageCommon.h"
#include "../Logic/managerment.h"

//////////////////////////////////////////////////////////////////////////////////	 
//本程序只供学习使用，未经作者许可，不得用于其它任何用途
//ALIENTEK战舰STM32开发板
//蜂鸣器驱动代码	   
//正点原子@ALIENTEK
//技术论坛:www.openedv.com
//修改日期:2012/9/2
//版本：V1.0
//版权所有，盗版必究。
//Copyright(C) 广州市星翼电子科技有限公司 2009-2019
//All rights reserved									  
////////////////////////////////////////////////////////////////////////////////// 	   

#define FILTERORDER 4

uint16_t adcBuff[3];
uint16_t arrayBuff[3][FILTERORDER];

ADCResTemp_TypeDef adcTemp[3];

//NTCResistor_T_R_TypeDef NTCResistor_50K3950_Table[] = 
//{
//	{	-40	,	1424.00	},
//	{	-39	,	1344.00	},
//	{	-38	,	1269.00	},
//	{	-37	,	1199.00	},
//	{	-36	,	1132.00	},
//	{	-35	,	1070.00	},
//	{	-34	,	1011.00	},
//	{	-33	,	955.20	},
//	{	-32	,	902.90	},
//	{	-31	,	853.50	},
//	{	-30	,	807.00	},
//	{	-29	,	763.00	},
//	{	-28	,	721.80	},
//	{	-27	,	682.70	},
//	{	-26	,	645.90	},
//	{	-25	,	611.20	},
//	{	-24	,	578.40	},
//	{	-23	,	547.50	},
//	{	-22	,	518.30	},
//	{	-21	,	490.80	},
//	{	-20	,	464.70	},
//	{	-19	,	439.50	},
//	{	-18	,	415.70	},
//	{	-17	,	393.40	},
//	{	-16	,	372.30	},
//	{	-15	,	352.50	},
//	{	-14	,	333.90	},
//	{	-13	,	316.40	},
//	{	-12	,	299.80	},
//	{	-11	,	284.30	},
//	{	-10	,	269.60	},
//	{	-9	,	255.70	},
//	{	-8	,	242.70	},
//	{	-7	,	230.30	},
//	{	-6	,	218.70	},
//	{	-5	,	207.70	},
//	{	-4	,	197.70	},
//	{	-3	,	187.50	},
//	{	-2	,	178.30	},
//	{	-1	,	169.50	},
//	{	0	,	161.20	},
//	{	1	,	153.40	},
//	{	2	,	145.90	},
//	{	3	,	138.90	},
//	{	4	,	132.30	},
//	{	5	,	126.00	},
//	{	6	,	120.00	},
//	{	7	,	114.30	},
//	{	8	,	109.00	},
//	{	9	,	103.90	},
//	{	10	,	99.08	},
//	{	11	,	94.51	},
//	{	12	,	90.17	},
//	{	13	,	86.05	},
//	{	14	,	82.14	},
//	{	15	,	78.42	},
//	{	16	,	74.89	},
//	{	17	,	71.54	},
//	{	18	,	68.35	},
//	{	19	,	65.32	},
//	{	20	,	62.440 	},
//	{	21	,	59.700 	},
//	{	22	,	57.090 	},
//	{	23	,	54.610 	},
//	{	24	,	52.250 	},
//	{	25	,	50.000 	},
//	{	26	,	47.870 	},
//	{	27	,	45.840 	},
//	{	28	,	43.910 	},
//	{	29	,	42.080 	},
//	{	30	,	40.330 	},
//	{	31	,	38.660 	},
//	{	32	,	37.070 	},
//	{	33	,	35.550 	},
//	{	34	,	34.110 	},
//	{	35	,	32.730 	},
//	{	36	,	31.410 	},
//	{	37	,	30.150 	},
//	{	38	,	28.950 	},
//	{	39	,	27.810 	},
//	{	40	,	26.720 	},
//	{	41	,	25.670 	},
//	{	42	,	24.670 	},
//	{	43	,	23.720 	},
//	{	44	,	22.810 	},
//	{	45	,	21.930 	},
//	{	46	,	21.100 	},
//	{	47	,	20.300 	},
//	{	48	,	19.540 	},
//	{	49	,	18.810 	},
//	{	50	,	18.110	},
//	{	51	,	17.440	},
//	{	52	,	16.790	},
//	{	53	,	16.180	},
//	{	54	,	15.590	},
//	{	55	,	15.020	},
//	{	56	,	14.480	},
//	{	57	,	13.960	},
//	{	58	,	13.460	},
//	{	59	,	12.990	},
//	{	60	,	12.530	},
//	{	61	,	12.090	},
//	{	62	,	22.670	},
//	{	63	,	11.260	},
//	{	64	,	10.870	},
//	{	65	,	10.500	},
//	{	66	,	10.140	},
//	{	67	,	9.792	},
//	{	68	,	9.460	},
//	{	69	,	9.141	},
//	{	70	,	8.834	},
//	{	71	,	8.539	},
//	{	72	,	8.256	},
//	{	73	,	7.983	},
//	{	74	,	7.720	},
//	{	75	,	7.468	},
//	{	76	,	7.225	},
//	{	77	,	6.991	},
//	{	78	,	6.765	},
//	{	79	,	6.548	},
//	{	80	,	6.3390 	},
//	{	81	,	6.1380 	},
//	{	82	,	5.9440 	},
//	{	83	,	5.7570 	},
//	{	84	,	5.5770 	},
//	{	85	,	5.4030 	},
//	{	86	,	5.2370 	},
//	{	87	,	5.0760 	},
//	{	88	,	4.9210 	},
//	{	89	,	4.7720 	},
//	{	90	,	4.6280 	},
//	{	91	,	4.4890 	},
//	{	92	,	4.3540 	},
//	{	93	,	4.2250 	},
//	{	94	,	4.0990 	},
//	{	95	,	3.9780 	},
//	{	96	,	9.8610 	},
//	{	97	,	3.7480 	},
//	{	98	,	3.6390 	},
//	{	99	,	3.5340 	},
//	{	100	,	3.4320 	},
//	{	101	,	3.3330 	},
//	{	102	,	3.2380 	},
//	{	103	,	3.1460 	},
//	{	104	,	3.0560 	},
//	{	105	,	2.9700 	},
//	{	106	,	2.8870 	},
//	{	107	,	2.8060 	},
//	{	108	,	2.7280 	},
//	{	109	,	2.6520 	},
//	{	110	,	2.5790	},
//	{	111	,	2.5080	},
//	{	112	,	2.3730	},
//	{	113	,	2.3080	},
//	{	114	,	2.2460	},
//	{	115	,	2.1860	},
//	{	116	,	2.1270	},
//	{	117	,	2.0700	},
//	{	118	,	2.0150	},
//	{	119	,	1.9620	},
//	{	120	,	1.9100	},
//	{	121	,	1.8600	},
//	{	122	,	1.8120	},
//	{	123	,	1.7650	},
//	{	124	,	1.7190	},
//	{	125	,	0.3454	},
//	{	126	,	1.6750	},
//	{	127	,	1.6320	},
//	{	128	,	1.5900	},
//	{	129	,	1.5500	},
//	{	130	,	1.5110	},
//	{	131	,	1.4730	},
//	{	132	,	1.4360	},
//	{	133	,	1.4000	},
//	{	134	,	1.3650	},
//	{	135	,	1.3310	},
//	{	136	,	1.2990	},
//	{	137	,	1.2670	},
//	{	138	,	1.2360	},
//	{	139	,	1.2060	},
//	{	140	,	1.1770 	},
//	{	141	,	1.1480 	},
//	{	142	,	1.1210 	},
//	{	143	,	1.0940 	},
//	{	144	,	1.0680 	},
//	{	145	,	1.0430 	},
//	{	146	,	1.0180 	},
//	{	147	,	0.9945 	},
//	{	148	,	0.9713 	},
//	{	149	,	0.9488 	},
//	{	150	,	0.9268 	},
//	{	151	,	0.9052 	},
//	{	152	,	0.8843 	},
//	{	153	,	0.8639 	},
//	{	154	,	0.8440 	},
//	{	155	,	0.8248 	},
//	{	156	,	0.8060 	},
//	{	157	,	0.7878 	},
//	{	158	,	0.7701 	},
//	{	159	,	0.7529 	},
//	{	160	,	0.7361 	},
//	{	161	,	0.7198 	},
//	{	162	,	0.7039 	},
//	{	163	,	0.6885 	},
//	{	164	,	0.6735 	},
//	{	165	,	0.6588 	},
//	{	166	,	0.6446 	},
//	{	167	,	0.6307 	},
//	{	168	,	0.6172 	},
//	{	169	,	0.6041 	},
//	{	170	,	0.5913	},
//};

const NTCResistor_T_R_TypeDef NTCResistor_50K3950_Table[] =   //PtResistor_1K3850_Table
{
	{	-50	,	803.0683842	},
	{	-49	,	807.0390585	},
	{	-48	,	811.0083235	},
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	{	500	,	2808.96125	},
};

//多阶滤波
static uint16_t orderFilter(uint16_t *array, uint8_t order)
{
	uint16_t average = 0;
	uint8_t averageCnt = 0;
	uint8_t i;
	
	for(i=0;i<order;i++)
	{
		average += (array[i] * (i+1));
		averageCnt += (i+1);
	}
	
	average /= averageCnt;
	return average;
}

uint16_t getADCValueAfterFilter(uint8_t channel)
{
	uint8_t i;
	
	for(i=0;i<FILTERORDER-1;i++)
	{
		arrayBuff[channel][i] = arrayBuff[channel][i+1];
	}
	arrayBuff[channel][FILTERORDER-1] = adcBuff[channel];
	
	return orderFilter(arrayBuff[channel], FILTERORDER);
}

//初始化PB8为输出口.并使能这个口的时钟		    
//蜂鸣器初始化
void NTCResitor_Init(void)
{
	uint16_t i;
	
	//初始化ADC
	Adc_Init(); 
	
	//开机更新缓冲区
	for(i=0;i<5000;i++);
	getADCValueAfterFilter(0);
	getADCValueAfterFilter(1);
	getADCValueAfterFilter(2);
	for(i=0;i<5000;i++);
	getADCValueAfterFilter(0);
	getADCValueAfterFilter(1);
	getADCValueAfterFilter(2);
	for(i=0;i<5000;i++);
	getADCValueAfterFilter(0);
	getADCValueAfterFilter(1);
	getADCValueAfterFilter(2);
	for(i=0;i<5000;i++);
	getADCValueAfterFilter(0);
	getADCValueAfterFilter(1);
	getADCValueAfterFilter(2);
}


void NTCResistorTask(void)
{
	uint8_t flag1, flag2, flag3;
	uint16_t i;
	
	adcTemp[0].adcVal = getADCValueAfterFilter(0);
	adcTemp[0].ntcResistor = (float)adcTemp[0].adcVal*PULLUPRESISTOR1/(float)(4096-adcTemp[0].adcVal);
	adcTemp[1].adcVal = getADCValueAfterFilter(1);
	adcTemp[1].ntcResistor = (float)adcTemp[1].adcVal*PULLUPRESISTOR2/(float)(4096-adcTemp[1].adcVal);
	adcTemp[2].adcVal = getADCValueAfterFilter(2);
	adcTemp[2].ntcResistor = (float)adcTemp[2].adcVal*PULLUPRESISTOR3/(float)(4096-adcTemp[2].adcVal);

	//cDebug("adcTemp[1].ntcResistor = %f\r\n", adcTemp[1].ntcResistor);
	
	flag1 = 0;
	flag2 = 0;
	flag3 = 0;
	for(i=0;i<550;i++)//SIZEOF(NTCResistor_50K3950_Table)-1     550
	{
		if(!flag1 && (adcTemp[0].ntcResistor > NTCResistor_50K3950_Table[i].resistorKOhm && adcTemp[0].ntcResistor <= NTCResistor_50K3950_Table[i+1].resistorKOhm))
		{
			adcTemp[0].temperature = (NTCResistor_50K3950_Table[i+1].temperature - NTCResistor_50K3950_Table[i].temperature)
							* (adcTemp[0].ntcResistor - NTCResistor_50K3950_Table[i].resistorKOhm)
							+ NTCResistor_50K3950_Table[i].temperature;
			//cDebug("adcTemp[0].temperature = %f\r\n", adcTemp[0].temperature);
			//SetTextFloat(STATUSPAGE_INDEX, STATUS_TEMPCUTOFF1_EDIT, adcTemp[0].temperature, 2, 1);
			if(pProjectMan->inStatusPageFlag)
			{
				xSemaphoreTake(pProjectMan->lcdUartSem, portMAX_DELAY);
				SetTextInt32(STATUSPAGE_INDEX, STATUS_TEMPCUTOFF1_EDIT, adcTemp[0].temperature, 1, 0);
				xSemaphoreGive(pProjectMan->lcdUartSem);
			}
			flag1 = 1;
		}
		if(!flag2 && (adcTemp[1].ntcResistor > NTCResistor_50K3950_Table[i].resistorKOhm && adcTemp[1].ntcResistor <= NTCResistor_50K3950_Table[i+1].resistorKOhm))
		{
			adcTemp[1].temperature = (NTCResistor_50K3950_Table[i+1].temperature - NTCResistor_50K3950_Table[i].temperature)
							* (adcTemp[1].ntcResistor - NTCResistor_50K3950_Table[i].resistorKOhm)
							+ NTCResistor_50K3950_Table[i].temperature;
			//cDebug("adcTemp[1].temperature = %f\r\n", adcTemp[1].temperature);
			//SetTextFloat(STATUSPAGE_INDEX, STATUS_TEMPCUTOFF2_EDIT, adcTemp[1].temperature, 2, 1);
			if(pProjectMan->inStatusPageFlag)
			{
				xSemaphoreTake(pProjectMan->lcdUartSem, portMAX_DELAY);
				SetTextInt32(STATUSPAGE_INDEX, STATUS_TEMPCUTOFF2_EDIT, adcTemp[1].temperature, 1, 0);
				xSemaphoreGive(pProjectMan->lcdUartSem);
			}
			flag2 = 1;
		}
		if(!flag3 && (adcTemp[2].ntcResistor > NTCResistor_50K3950_Table[i].resistorKOhm && adcTemp[2].ntcResistor <= NTCResistor_50K3950_Table[i+1].resistorKOhm))
		{
			adcTemp[2].temperature = (NTCResistor_50K3950_Table[i+1].temperature - NTCResistor_50K3950_Table[i].temperature)
							* (adcTemp[2].ntcResistor - NTCResistor_50K3950_Table[i].resistorKOhm)
							+ NTCResistor_50K3950_Table[i].temperature;
			//cDebug("adcTemp[2].temperature = %f\r\n", adcTemp[2].temperature);
			//SetTextFloat(STATUSPAGE_INDEX, STATUS_TEMPFUSING_EDIT, adcTemp[2].temperature, 2, 1);
			if(pProjectMan->inStatusPageFlag)
			{
				xSemaphoreTake(pProjectMan->lcdUartSem, portMAX_DELAY);
				SetTextInt32(STATUSPAGE_INDEX, STATUS_TEMPFUSING_EDIT, adcTemp[2].temperature, 1, 0);
				xSemaphoreGive(pProjectMan->lcdUartSem);
			}
			flag3 = 1;
		}
		if(flag1 && flag2 && flag3)
			break;
	}
}
